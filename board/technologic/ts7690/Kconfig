## board/technologic/ts7690/Kconfig
```kconfig
if TARGET_TS7690

config SYS_BOARD
	default "ts7690"

config SYS_VENDOR
	default "technologic"

config SYS_SOC
	default "mxs"

config SYS_CONFIG_NAME
	default "ts7690"

endif
```
